## prj.conf
```kconfig
# Debugger Support
CONFIG_UART_CONSOLE=y
CONFIG_CONSOLE=y

# Power Management
#CONFIG_PM=y
#CONFIG_PM_DEVICE=y
```

## boards/stm32wl_dw1000_iot_board.overlay
```dts
/*
 * Copyright (c) 2023
 * Regis Rousseau
 * Univ Lyon, INSA Lyon, Inria, CITI, EA3720
 * SPDX-License-Identifier: Apache-2.0
 */

/* configuration of ADC for geophone sensor */
/* adjust channel number according to pinmux in board.dts */
/* see datasheet Pinout Config pg 56/149 */
		// PB13 ADC_GSONE -> ADC_IN0

/ {
	zephyr,user {
		io-channels = <&adc1 13 >;
	};
};

&adc1 {
	#address-cells = <1>;
	#size-cells = <0>;

	pinctrl-0 = <&adc_in0_pb13>;
	pinctrl-names = "default";
	status = "okay";

	channel@0 {
		reg = <0>;
		zephyr,gain = "ADC_GAIN_1";
		zephyr,reference = "ADC_REF_INTERNAL";
		zephyr,acquisition-time = <ADC_ACQ_TIME_DEFAULT>;
		zephyr,resolution = <12>;
	};
};

	
	
	
```

## src/main.c
```c
/*
 * Copyright (c) 2023
 * Regis Rousseau
 * Univ Lyon, INSA Lyon, Inria, CITI, EA3720
 * SPDX-License-Identifier: Apache-2.0
 */

#include <zephyr/kernel.h>
#include <zephyr/device.h>

int8_t main(void)
{
	printk("Hello World! %s\n", CONFIG_BOARD);
	return 0;
}
```
